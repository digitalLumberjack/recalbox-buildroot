## package/advancemame/Config.in
```kconfig
config BR2_PACKAGE_ADVANCEMAME
        bool "advancemame"
        help
          Advance Mame for ARM.

	  http://www.advancemame.it/
```

## package/libretro-2048/Config.in
```kconfig
config BR2_PACKAGE_LIBRETRO_2048
        bool "libretro-2048"
	depends on BR2_PACKAGE_RETROARCH
        help
          A libretro 2048 core for ARM.

	  http://www.libretro.com

comment "LIBRETRO_2048 needs a toolchain w/ C++"
```

## package/libretro-atari800/Config.in
```kconfig
config BR2_PACKAGE_LIBRETRO_ATARI800
        bool "libretro-atari800"
	depends on BR2_PACKAGE_RETROARCH
	depends on BR2_INSTALL_LHASA
        help
          A libretro Atari 800 core for ARM.

	  http://www.libretro.com

comment "LIBRETRO_ATARI800 needs a toolchain w/ C++"
	depends on !BR2_INSTALL_LHASA
```

## package/libretro-bsnes-mercury/Config.in
```kconfig
config BR2_PACKAGE_LIBRETRO_BSNES_MERCURY
        bool "bsnes_mercury_accuracy_libretro.so"
	depends on BR2_PACKAGE_RETROARCH
	depends on BR2_INSTALL_LIBSTDCPP
        help
          An alternative libretro SNES emulator core for ARM.

	  http://www.libretro.com

comment "LIBRETRO_BSNES_MERCURY needs a toolchain w/ C++"
	depends on !BR2_INSTALL_LIBSTDCPP
```

## package/libretro-dinothawr/Config.in
```kconfig
config BR2_PACKAGE_LIBRETRO_DINOTHAWR
        bool "libretro-dinothawr"
	depends on BR2_PACKAGE_RETROARCH
        help
          A libretro dinothawr core for ARM.

	  http://www.libretro.com

comment "LIBRETRO_DINOTHAWR needs a toolchain w/ C++"
```

## package/libretro-dosbox/Config.in
```kconfig
config BR2_PACKAGE_LIBRETRO_DOSBOX
        bool "libretro-dosbox"
	depends on BR2_PACKAGE_RETROARCH
	depends on BR2_PACKAGE_SDL
	depends on BR2_PACKAGE_SDL_GFX
	depends on BR2_PACKAGE_SDL_IMAGE
	depends on BR2_PACKAGE_SDL_MIXER
	depends on BR2_PACKAGE_SDL_NET
	depends on BR2_PACKAGE_SDL_SOUND
	depends on BR2_PACKAGE_SDL_TTF
	depends on BR2_PACKAGE_LIBPNG
	depends on BR2_PACKAGE_LIBASOUND
        help
          A libretro dosbox core for ARM.

	  http://www.libretro.com

comment "LIBRETRO_DOSBOX needs a toolchain w/ C++"
```

## package/libretro-reicast/Config.in
```kconfig
config BR2_PACKAGE_LIBRETRO_REICAST
        bool "libretro-reicast"
	depends on BR2_PACKAGE_SDL2
	depends on BR2_INSTALL_LIBSTDCPP
        help
          A libretro reicast  core for ARM.

	  http://www.libretro.com

comment "LIBRETRO_REICAST needs a toolchain w/ C++"
	depends on !BR2_INSTALL_LIBSTDCPP
```

## package/libretro-tyrquake/Config.in
```kconfig
config BR2_PACKAGE_LIBRETRO_TYRQUAKE
        bool "libretro-tyrquake"
	depends on BR2_PACKAGE_RETROARCH
	depends on BR2_INSTALL_LHASA
        help
          A libretro tyrquake core for ARM.

	  http://www.libretro.com

comment "LIBRETRO_TYRQUAKE needs a toolchain w/ C++"
	depends on !BR2_INSTALL_LHASA
```

## package/pokemini/config.in
```kconfig
config BR2_PACKAGE_POKEMINI
        bool "pokemini"
        depends on BR2_PACKAGE_SDL2
        depends on BR2_PACKAGE_ZLIB
        depends on BR2_PACKAGE_HAS_UDEV
        help
          A Pokemini emulator core for SDL.
```

## package/pwm-audio-pizero/Config.in
```kconfig
config BR2_PACKAGE_PWM_AUDIO_PIZERO
	bool "pwm-audio-pizero"
	depends on BR2_PACKAGE_RPI_FIRMWARE
	help
	  A DTBO to redirect pizero pwm on externel GPIO Pinout to get sound
```

## package/rpi-fbcp/Config.in
```kconfig
config BR2_PACKAGE_RPI_FBCP
    bool "rpi-fbcp"
    help
		Raspberry Pi utility. Used for mirror primary framebuffer to secondary framebuffer.

		https://github.com/tasanakorn/rpi-fbcp
```
